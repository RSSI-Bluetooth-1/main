## scan_adv_daniel/build/Kconfig/Kconfig.shield
```kconfig
osource "c:/nordic_projects/scan_adv/boards/shields/*/Kconfig.shield"
osource "c:/nordic_projects/scan_adv_dongle/boards/shields/*/Kconfig.shield"
osource "c:/nordic_projects/scan_adv_DK/boards/shields/*/Kconfig.shield"
osource "c:/ncs/v2.3.0/zephyr/boards/shields/*/Kconfig.shield"
osource "c:/nordic_projects/scan_adv_daniel/boards/shields/*/Kconfig.shield"
osource "C:/ncs/v2.3.0/nrf/boards/shields/*/Kconfig.shield"
```

## scan_adv_daniel/build/Kconfig/Kconfig.shield.defconfig
```kconfig
osource "c:/nordic_projects/scan_adv/boards/shields/*/Kconfig.defconfig"
osource "c:/nordic_projects/scan_adv_dongle/boards/shields/*/Kconfig.defconfig"
osource "c:/nordic_projects/scan_adv_DK/boards/shields/*/Kconfig.defconfig"
osource "c:/ncs/v2.3.0/zephyr/boards/shields/*/Kconfig.defconfig"
osource "c:/nordic_projects/scan_adv_daniel/boards/shields/*/Kconfig.defconfig"
osource "C:/ncs/v2.3.0/nrf/boards/shields/*/Kconfig.defconfig"
```
